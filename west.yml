## west.yml
```yaml
manifest:
  version: "1.2"

  self:
    path: shared
    west-commands: scripts/west-commands.yml

  remotes:
    - name: origin
      url-base: https://github.com/JaagupAverin

  projects:
    - name: gale-zephyr
      path: zephyr
      remote: origin
      revision: main
      import:
        name-whitelist:
          - hal_espressif
```
